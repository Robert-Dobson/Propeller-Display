// #include <Arduino.h>
#include <math.h>
#include <time.h>

// Characters
unsigned char Alphabet[26][8]=
   {{0,0b01111111,0b11111111,0b11001100,0b11001100,0b11001100,0b11111111,0b01111111},
    {0,0b00111100,0b01111110,0b11011011,0b11011011,0b11011011,0b11111111,0b11111111},
    {0,0b11000011,0b11000011,0b11000011,0b11000011,0b11100111,0b01111110,0b00111100},
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    {0b11000011,0b11100011,0b11110011,0b11111011,0b11011111,0b11001111,0b11000111,0b11000011}
    };

int spaceSize = 8;
int spaceBetweenLetters = 1;


unsigned char* convertStringToFrame(char* text){
    unsigned char* frame = (unsigned char*) malloc((sizeof(*text) * 8 +  spaceBetweenLetters)* sizeof(unsigned char));
    int pointerOffset = 0; // Keeping track of position in frame

    if (frame != NULL){
        // Iterate through each letter of string
        int length = sizeof(text)/sizeof(char);
        for (int i = 0; i < length; i++){

            char letter = text[i];
            if (letter == ' '){
                // If string is space, just leave blank space in frame
                for (int i = 0; i < spaceSize; i++){
                    frame[pointerOffset] = 0; 
                    pointerOffset++;
                }
            } else if(65 < letter < 90){
                // Otherwise copy in slices from alphabet
                for (int i = 0; i < 8; i++){
                    frame[pointerOffset] = Alphabet[getCharFrameIndex(letter)][i];
                    pointerOffset++;
                }
            }

            // Add space between letters
            for (int i = 0; i < spaceBetweenLetters; i++){
                frame[pointerOffset] = 0;
                pointerOffset++;
            }
        }
    }
    return frame;
}

int getCharFrameIndex(char letter){
    int index = letter - 65;
    return index;
}